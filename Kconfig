## Kconfig
```kconfig
mainmenu "Lemon build configuration"

#--------------------------------------------------------------------------------------------------
# Global configuration
#--------------------------------------------------------------------------------------------------
menu "Global configuration"
	choice
		prompt "System and applications language"
		default GLOBAL_LANGUAGE_FRENCH

		config GLOBAL_LANGUAGE_ENGLISH
			bool "English (not yet available)"

		config GLOBAL_LANGUAGE_FRENCH
			bool "French"

		config GLOBAL_LANGUAGE_ITALIAN
			bool "Italian (not yet available)"
	endchoice

	config GLOBAL_PROCESSOR_CODE_NAME
		string "Target processor GCC code name"
		default "pentium"
		help
			See GCC "-march" help for x86 architecture for a full list of supported processor code names.
			
endmenu

#--------------------------------------------------------------------------------------------------
# System
#--------------------------------------------------------------------------------------------------
menu "System"
	config SYSTEM_TOTAL_RAM_SIZE_MEGA_BYTES
		int "Allowed RAM amount in megabytes"
		default 16

	config SYSTEM_IS_DEBUG_ENABLED
		bool "Enable debugging messages"
		default false

	config SYSTEM_FILE_SYSTEM_MAXIMUM_FILES_LIST_ENTRIES
		int "File system maximum files count"
		default 128

	config SYSTEM_FILE_SYSTEM_MAXIMUM_BLOCKS_LIST_ENTRIES
		int "File system maximum 4096-byte storage blocks"
		default 2048

	choice
		prompt "Ethernet controller"
		default SYSTEM_ETHERNET_CONTROLLER_DRIVER_NONE

		config SYSTEM_ETHERNET_CONTROLLER_DRIVER_NONE
			bool "Disabled"

		config SYSTEM_ETHERNET_CONTROLLER_DRIVER_82540EM
			bool "Intel 82540EM"

		config SYSTEM_ETHERNET_CONTROLLER_DRIVER_RTL8111
			bool "Realtek RTL8111 (not ready yet)"
	endchoice
endmenu

#--------------------------------------------------------------------------------------------------
# Hard disk
#--------------------------------------------------------------------------------------------------
menu "Hard disk"
	choice
		prompt "Hard disk driver"
		default SYSTEM_HARD_DISK_DRIVER_IDE

		config SYSTEM_HARD_DISK_DRIVER_IDE
			bool "IDE"

		config SYSTEM_HARD_DISK_DRIVER_SATA
			bool "SATA"

		config SYSTEM_HARD_DISK_DRIVER_RAM
			bool "RAM device"
	endchoice

	choice
		prompt "IDE bus"
		default SYSTEM_HARD_DISK_DRIVER_IDE_BUS_PRIMARY
		depends on SYSTEM_HARD_DISK_DRIVER_IDE

		config SYSTEM_HARD_DISK_DRIVER_IDE_BUS_PRIMARY
			bool "Primary"

		config SYSTEM_HARD_DISK_DRIVER_IDE_BUS_SECONDARY
			bool "Secondary"
	endchoice

	choice
		prompt "IDE drive"
		default SYSTEM_HARD_DISK_DRIVER_IDE_DRIVE_MASTER
		depends on SYSTEM_HARD_DISK_DRIVER_IDE

		config SYSTEM_HARD_DISK_DRIVER_IDE_DRIVE_MASTER
			bool "Master"

		config SYSTEM_HARD_DISK_DRIVER_IDE_DRIVE_SLAVE
			bool "Slave"
	endchoice

	config SYSTEM_HARD_DISK_DRIVER_SATA_DRIVE_INDEX
		int "SATA port the hard disk is connected to (from 0 to 31)"
		default 0
		depends on SYSTEM_HARD_DISK_DRIVER_SATA

	choice
		prompt "Logical Block Addressing (LBA) mode"
		default SYSTEM_HARD_DISK_LOGICAL_BLOCK_ADDRESSING_MODE_28
		depends on SYSTEM_HARD_DISK_DRIVER_IDE || SYSTEM_HARD_DISK_DRIVER_SATA

		config SYSTEM_HARD_DISK_LOGICAL_BLOCK_ADDRESSING_MODE_28
			bool "LBA-28"

		config SYSTEM_HARD_DISK_LOGICAL_BLOCK_ADDRESSING_MODE_48
			bool "LBA-48"
	endchoice
endmenu

#--------------------------------------------------------------------------------------------------
# Installer
#--------------------------------------------------------------------------------------------------
menu "Installer"
	config INSTALLER_FILES_LIST
		string "Automatically installed files"
		default "Applications/Binaries/benchmark;Applications/Binaries/chat;Applications/Binaries/edit;Applications/Binaries/games;Applications/Binaries/help;Applications/Resources/System.cfg;Applications/Binaries/tests;Applications/Binaries/u"
		help
			A semicolon-separated list of files to automatically install during system installation.
			File paths start from Lemon directory.
			This list must not contain any space (nor escaped space with \ or "").
			
endmenu
```
